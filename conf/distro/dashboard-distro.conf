## conf/distro/dashboard-distro.conf
```bitbake
MAINTAINER = "Soliman <ahmedsliman215@gmail.com>"

require conf/distro/poky.conf

DISTRO = "dashboard-distro"
DISTRO_NAME = "dashboard distro"
DISTRO_VERSION = "1.0"

# set hostname
hostname_pn-base-files = "Dashboard@RPI"

DISTRO_FEATURES:append = "opengl eglfs qt5 systemd wifi"
DISTRO_FEATURES:remove = "x11 wayland"
VIRTUAL-RUNTIME:init_manager = "systemd"           

# set default time zone
DEFAULT_TIMEZONE = "Africa/Cairo"
```

## conf/layer.conf
```bitbake
# We have a conf and classes directory, add to BBPATH
BBPATH .= ":${LAYERDIR}"

# We have recipes-* directories, add to BBFILES
BBFILES += "${LAYERDIR}/recipes-*/*/*.bb \
            ${LAYERDIR}/recipes-*/*/*.bbappend"

BBFILE_COLLECTIONS += "dashboard"
BBFILE_PATTERN_dashboard = "^${LAYERDIR}/"
BBFILE_PRIORITY_dashboard = "6"

LAYERDEPENDS_dashboard = "core"
LAYERSERIES_COMPAT_dashboard = "dunfell"
```
